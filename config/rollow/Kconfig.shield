## config/rollow/Kconfig.shield
```kconfig
8 lines (6 sloc)  209 Bytes

# Copyright (c) 2020 Ryan Cross
# SPDX-License-Identifier: MIT

config SHIELD_ROLLOW_LEFT
	def_bool $(shields_list_contains,rollow_left)

config SHIELD_ROLLOW_RIGHT
	def_bool $(shields_list_contains,rollow_right)
```

## config/west.yml
```yaml
manifest:
  remotes:
    - name: zmkfirmware
      url-base: https://github.com/zmkfirmware
    - name: infused-kim
      url-base: https://github.com/infused-kim
    - name: barbellboards
      url-base: https://github.com/barbellboards
  projects:
    - name: zmk
      remote: infused-kim
      revision: sofle
      import: app/west.yml
  self:
    path: config
```
